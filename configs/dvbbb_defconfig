## configs/dvbbb_defconfig
```kconfig
BR2_arm=y
BR2_cortex_a8=y
BR2_TOOLCHAIN_BUILDROOT_VENDOR="brbbb"
BR2_PACKAGE_HOST_LINUX_HEADERS_CUSTOM_4_4=y
BR2_TOOLCHAIN_BUILDROOT_INET_RPC=y
BR2_TOOLCHAIN_BUILDROOT_LOCALE=y
BR2_TOOLCHAIN_BUILDROOT_USE_SSP=y
BR2_TOOLCHAIN_BUILDROOT_CXX=y
BR2_GCC_ENABLE_LTO=y
BR2_PACKAGE_HOST_GDB=y
BR2_TARGET_GENERIC_HOSTNAME="dvb"
BR2_TARGET_GENERIC_PASSWD_SHA256=y
BR2_INIT_RUND=y
BR2_ROOTFS_DEVICE_CREATION_DYNAMIC_EUDEV=y
BR2_SYSTEM_BIN_SH_MKSH=y
BR2_TARGET_GENERIC_GETTY_PORT="ttyO0"
# BR2_TARGET_GENERIC_REMOUNT_ROOTFS_RW is not set
BR2_PERSISTENTFS="/dev/mmcblk1p3 /dev/mmcblk0p3"
BR2_PERSISTENTFSDIRS="/root /home /var /etc/mumudvb.conf"
BR2_ENABLE_LOCALE_WHITELIST="C en_GB nl fr"
BR2_TARGET_TZ_INFO=y
BR2_ROOTFS_USERS_TABLES="projects/dvb/usertable.txt"
BR2_ROOTFS_OVERLAY="projects/dvb/rootfs"
BR2_ROOTFS_POST_BUILD_SCRIPT="projects/dvb/post-build.sh"
BR2_LINUX_KERNEL=y
BR2_LINUX_KERNEL_CUSTOM_GIT=y
BR2_LINUX_KERNEL_CUSTOM_REPO_URL="git://github.com/beagleboard/linux.git"
BR2_LINUX_KERNEL_CUSTOM_REPO_VERSION="528fcb73872cf15e2a8890c3a0b7686cd64bc801"
BR2_LINUX_KERNEL_USE_CUSTOM_CONFIG=y
BR2_LINUX_KERNEL_CUSTOM_CONFIG_FILE="projects/dvb/linux.config"
BR2_LINUX_KERNEL_DTS_SUPPORT=y
BR2_LINUX_KERNEL_INTREE_DTS_NAME="am335x-boneblack am335x-bonegreen"
BR2_PACKAGE_BUSYBOX_CONFIG="projects/dvb/busybox.+config"
BR2_PACKAGE_BUSYBOX_SHOW_OTHERS=y
BR2_PACKAGE_DVBFEMON=y
BR2_PACKAGE_DVBLAST=y
BR2_PACKAGE_MUMUDVB=y
BR2_PACKAGE_LTRACE=y
BR2_PACKAGE_STRACE=y
BR2_PACKAGE_DOSFSTOOLS=y
BR2_PACKAGE_DOSFSTOOLS_FATLABEL=y
BR2_PACKAGE_DOSFSTOOLS_FSCK_FAT=y
BR2_PACKAGE_DOSFSTOOLS_MKFS_FAT=y
BR2_PACKAGE_E2FSPROGS=y
BR2_PACKAGE_MMC_UTILS=y
BR2_PACKAGE_AM33X_CM3=y
BR2_PACKAGE_LINUX_FIRMWARE=y
BR2_PACKAGE_LINUX_FIRMWARE_DIB0700=y
BR2_PACKAGE_DBUS=y
# BR2_PACKAGE_EUDEV_ENABLE_HWDB is not set
BR2_PACKAGE_I2C_TOOLS=y
BR2_PACKAGE_INPUTEVENT=y
BR2_PACKAGE_W_SCAN=y
BR2_PACKAGE_LZO=y
BR2_PACKAGE_LIBWEBSOCKETS=y
BR2_PACKAGE_CGIFORMHELPER=y
BR2_PACKAGE_DROPBEAR=y
BR2_PACKAGE_DROPBEAR_DISABLE_REVERSEDNS=y
BR2_PACKAGE_DROPBEAR_WTMP=y
BR2_PACKAGE_DROPBEAR_LASTLOG=y
BR2_PACKAGE_ETHTOOL=y
BR2_PACKAGE_IFPLUGD=y
BR2_PACKAGE_IPUTILS=y
BR2_PACKAGE_MII_DIAG=y
BR2_PACKAGE_MOSQUITTO=y
BR2_PACKAGE_NETCAT=y
BR2_PACKAGE_NTP=y
BR2_PACKAGE_RSYNC=y
BR2_PACKAGE_HTOP=y
BR2_PACKAGE_PROCPS_NG=y
BR2_PACKAGE_PSMISC=y
BR2_TARGET_ROOTFS_CPIO=y
BR2_TARGET_ROOTFS_CPIO_LZO=y
BR2_TARGET_ROOTFS_CPIO_UIMAGE=y
BR2_TARGET_ROOTFS_TAR_GZIP=y
BR2_TARGET_UBOOT=y
BR2_TARGET_UBOOT_BUILD_SYSTEM_KCONFIG=y
BR2_TARGET_UBOOT_BOARD_DEFCONFIG="am335x_boneblack"
BR2_TARGET_UBOOT_FORMAT_IMG=y
BR2_TARGET_UBOOT_SPL=y
BR2_TARGET_UBOOT_SPL_NAME="MLO"
BR2_PACKAGE_HOST_MKE2IMG=y
```

## configs/musicbox_defconfig
```kconfig
BR2_arm=y
BR2_arm1176jzf_s=y
BR2_KERNEL_HEADERS_VERSION=y
BR2_DEFAULT_KERNEL_VERSION="4.1.5"
BR2_PACKAGE_HOST_LINUX_HEADERS_CUSTOM_4_1=y
BR2_TOOLCHAIN_BUILDROOT_WCHAR=y
BR2_TOOLCHAIN_BUILDROOT_CXX=y
BR2_TARGET_GENERIC_PASSWD_SHA256=y
BR2_INIT_RUND=y
BR2_ROOTFS_DEVICE_CREATION_DYNAMIC_EUDEV=y
BR2_TARGET_GENERIC_GETTY_PORT="ttyAMA0"
BR2_TARGET_GENERIC_GETTY_BAUDRATE_115200=y
# BR2_TARGET_GENERIC_REMOUNT_ROOTFS_RW is not set
BR2_PERSISTENTFS="/dev/mmcblk0p3"
BR2_TARGET_TZ_INFO=y
BR2_TARGET_LOCALTIME="CET"
BR2_ROOTFS_OVERLAY="projects/musicbox/rootfs"
BR2_LINUX_KERNEL=y
BR2_LINUX_KERNEL_CUSTOM_GIT=y
BR2_LINUX_KERNEL_CUSTOM_REPO_URL="https://github.com/raspberrypi/linux.git"
BR2_LINUX_KERNEL_CUSTOM_REPO_VERSION="293a18f1a3cdccce7da2cef0a2166f3340a1c5d8"
BR2_LINUX_KERNEL_USE_CUSTOM_CONFIG=y
BR2_LINUX_KERNEL_CUSTOM_CONFIG_FILE="projects/musicbox/linux.config"
BR2_LINUX_KERNEL_ZIMAGE=y
BR2_LINUX_KERNEL_DTS_SUPPORT=y
BR2_LINUX_KERNEL_INTREE_DTS_NAME="bcm2835-rpi-b bcm2835-rpi-b-plus bcm2835-rpi-a-plus"
BR2_PACKAGE_BUSYBOX_CONFIG="projects/wifitestap/busybox.config"
BR2_PACKAGE_BUSYBOX_SHOW_OTHERS=y
BR2_PACKAGE_ALSA_UTILS=y
BR2_PACKAGE_ALSA_UTILS_AMIXER=y
BR2_PACKAGE_ESPEAK=y
BR2_PACKAGE_ESPEAK_AUDIO_BACKEND_ALSA=y
BR2_PACKAGE_MPD=y
BR2_PACKAGE_MPD_LIBSOXR=y
BR2_PACKAGE_MPD_FAAD2=y
BR2_PACKAGE_MPD_VORBIS=y
BR2_PACKAGE_MPD_AVAHI_SUPPORT=y
BR2_PACKAGE_MPD_MPC=y
BR2_PACKAGE_SOX=y
BR2_PACKAGE_UPMPDCLI=y
BR2_PACKAGE_YMPD=y
BR2_PACKAGE_STRACE=y
BR2_PACKAGE_E2FSPROGS=y
# BR2_PACKAGE_E2FSPROGS_E2UNDO is not set
BR2_PACKAGE_MMC_UTILS=y
BR2_PACKAGE_LINUX_FIRMWARE=y
BR2_PACKAGE_LINUX_FIRMWARE_RALINK_RT61=y
BR2_PACKAGE_LINUX_FIRMWARE_RALINK_RT73=y
BR2_PACKAGE_LINUX_FIRMWARE_RALINK_RT2XX=y
BR2_PACKAGE_LINUX_FIRMWARE_RTL_81XX=y
BR2_PACKAGE_LINUX_FIRMWARE_RTL_87XX=y
BR2_PACKAGE_LINUX_FIRMWARE_RTL_88XX=y
BR2_PACKAGE_RPI_FIRMWARE=y
# BR2_PACKAGE_RPI_FIRMWARE_INSTALL_DTB_OVERLAYS is not set
BR2_PACKAGE_RPI_FIRMWARE_EXTRA_PATH="projects/musicbox/"
BR2_PACKAGE_INPUTEVENT=y
BR2_PACKAGE_IOSTAT=y
BR2_PACKAGE_LIBGLIB2=y
BR2_PACKAGE_CRDA=y
BR2_PACKAGE_DROPBEAR=y
BR2_PACKAGE_DROPBEAR_DISABLE_REVERSEDNS=y
BR2_PACKAGE_DROPBEAR_WTMP=y
BR2_PACKAGE_DROPBEAR_LASTLOG=y
BR2_PACKAGE_ETHTOOL=y
BR2_PACKAGE_IFPLUGD=y
BR2_PACKAGE_IPUTILS=y
BR2_PACKAGE_IW=y
BR2_PACKAGE_MII_DIAG=y
BR2_PACKAGE_RSYNC=y
BR2_PACKAGE_SHAIRPORT_SYNC=y
BR2_PACKAGE_SHAIRPORT_SYNC_LIBSOXR=y
BR2_PACKAGE_WIRELESS_TOOLS=y
BR2_PACKAGE_WPA_SUPPLICANT=y
BR2_PACKAGE_WPA_SUPPLICANT_DEBUG_SYSLOG=y
BR2_PACKAGE_WPA_SUPPLICANT_CLI=y
BR2_TARGET_ROOTFS_CPIO=y
BR2_TARGET_ROOTFS_CPIO_LZO=y
```

## configs/wifitestap_defconfig
```kconfig
BR2_arm=y
BR2_arm1176jzf_s=y
BR2_KERNEL_HEADERS_VERSION=y
BR2_DEFAULT_KERNEL_VERSION="4.1.5"
BR2_PACKAGE_HOST_LINUX_HEADERS_CUSTOM_4_1=y
BR2_TOOLCHAIN_BUILDROOT_WCHAR=y
BR2_TOOLCHAIN_BUILDROOT_CXX=y
BR2_TARGET_GENERIC_PASSWD_SHA256=y
BR2_INIT_RUND=y
BR2_ROOTFS_DEVICE_CREATION_DYNAMIC_EUDEV=y
BR2_TARGET_GENERIC_GETTY_PORT="ttyAMA0"
BR2_TARGET_GENERIC_GETTY_BAUDRATE_115200=y
# BR2_TARGET_GENERIC_REMOUNT_ROOTFS_RW is not set
BR2_PERSISTENTFS="/dev/mmcblk0p3"
BR2_TARGET_TZ_INFO=y
BR2_TARGET_LOCALTIME="CET"
BR2_ROOTFS_OVERLAY="projects/wifitestap/rootfs"
BR2_LINUX_KERNEL=y
BR2_LINUX_KERNEL_CUSTOM_GIT=y
BR2_LINUX_KERNEL_CUSTOM_REPO_URL="https://github.com/raspberrypi/linux.git"
BR2_LINUX_KERNEL_CUSTOM_REPO_VERSION="592503752b6951972f161f04280683c5af38d173"
BR2_LINUX_KERNEL_USE_CUSTOM_CONFIG=y
BR2_LINUX_KERNEL_CUSTOM_CONFIG_FILE="projects/wifitestap/linux.config"
BR2_LINUX_KERNEL_ZIMAGE=y
BR2_LINUX_KERNEL_DTS_SUPPORT=y
BR2_LINUX_KERNEL_INTREE_DTS_NAME="bcm2708-rpi-b bcm2708-rpi-b-plus"
BR2_PACKAGE_BUSYBOX_CONFIG="projects/wifitestap/busybox.config"
BR2_PACKAGE_BUSYBOX_SHOW_OTHERS=y
BR2_PACKAGE_STRACE=y
BR2_PACKAGE_E2FSPROGS=y
# BR2_PACKAGE_E2FSPROGS_E2UNDO is not set
BR2_PACKAGE_MMC_UTILS=y
BR2_PACKAGE_LINUX_FIRMWARE=y
BR2_PACKAGE_LINUX_FIRMWARE_BRCM_BCM43XX=y
BR2_PACKAGE_LINUX_FIRMWARE_BRCM_BCM43XXX=y
BR2_PACKAGE_LINUX_FIRMWARE_RALINK_RT61=y
BR2_PACKAGE_LINUX_FIRMWARE_RALINK_RT73=y
BR2_PACKAGE_LINUX_FIRMWARE_RALINK_RT2XX=y
BR2_PACKAGE_LINUX_FIRMWARE_RTL_81XX=y
BR2_PACKAGE_LINUX_FIRMWARE_RTL_87XX=y
BR2_PACKAGE_LINUX_FIRMWARE_RTL_88XX=y
BR2_PACKAGE_RPI_FIRMWARE=y
# BR2_PACKAGE_RPI_FIRMWARE_INSTALL_DTB_OVERLAYS is not set
BR2_PACKAGE_RPI_FIRMWARE_EXTRA_PATH="projects/wifitestap/"
BR2_PACKAGE_CRDA=y
BR2_PACKAGE_DNSMASQ=y
BR2_PACKAGE_DROPBEAR=y
BR2_PACKAGE_DROPBEAR_DISABLE_REVERSEDNS=y
BR2_PACKAGE_DROPBEAR_WTMP=y
BR2_PACKAGE_DROPBEAR_LASTLOG=y
BR2_PACKAGE_ETHTOOL=y
BR2_PACKAGE_HOSTAPD=y
BR2_PACKAGE_IFPLUGD=y
BR2_PACKAGE_IPUTILS=y
BR2_PACKAGE_IW=y
BR2_PACKAGE_MII_DIAG=y
BR2_PACKAGE_NETWORKTEST=y
BR2_PACKAGE_WIRELESS_TOOLS=y
BR2_PACKAGE_WPA_SUPPLICANT=y
BR2_PACKAGE_WPA_SUPPLICANT_DEBUG_SYSLOG=y
BR2_PACKAGE_WPA_SUPPLICANT_CLI=y
BR2_TARGET_ROOTFS_CPIO=y
BR2_TARGET_ROOTFS_CPIO_LZO=y
```

## package/cgiformhelper/Config.in
```kconfig
config BR2_PACKAGE_CGIFORMHELPER
	bool "cgiformhelper"
	help
	  cgiformhelper is a program that parses CGI POST data
	  in a "1 file per variable" way.
	  Accessing CGI data from shell scripts becomes as easy
	  as accessing files.
```

## package/database/Config.in
```kconfig
menu "Database"
source "package/database/mysql_client/Config.in"
source "package/database/sqlite/Config.in"
source "package/database/sqlitedbms/Config.in"
endmenu
```

## package/database/sqlitedbms/Config.in
```kconfig
config BR2_PACKAGE_SQLITEDBMS
	bool "sqlitedbms"
	default n
	select BR2_PACKAGE_SQLITE
	help
	  this is a TCP/IP access layer for SQLite
	  SQLite is a small C library that implements a self-contained,
	  embeddable, zero-configuration SQL database engine.
	  
	  http://sqlitedbms.sourceforge.net
```

## package/dvbfemon/Config.in
```kconfig
config BR2_PACKAGE_DVBFEMON
	bool "dvbfemon"
	help
	  dvbfemon is a simple tool to monitor the DVB tuner signal status
	  like during antenna positioning.
	  It prints some relevant parameters to stdout.

	  https://github.com/kurt-vd/dvbvemon
```

## package/inputevent/Config.in
```kconfig
config BR2_PACKAGE_INPUTEVENT
	bool "inputevent"
	help
	  inputevent is a simple program that traces input events.
	  When piped to a another program or script, you get similar
	  functionality as input-event-daemon.
```

## package/libio/Config.in
```kconfig
config BR2_PACKAGE_LIBIO
	bool "libio utilities"
	help
	  libio is a set of small IO handling uitilities.

if BR2_PACKAGE_LIBIO
config BR2_PACKAGE_LIBIO_PRESET
	string "predefined automation to install"
	help
	  Select the automation scripts to install. Supported values are
	  ha2	- My first home 2nd floor automation
	  mb	- Macbook
endif
```

## package/libsigc/Config.in
```kconfig
config BR2_PACKAGE_LIBSIGC
	bool "libsigc++"
	depends on BR2_INSTALL_LIBSTDCPP
	help
	  The LibSigC++

	  http://libsigc.sourceforge.net

comment "libsigc++ requires a toolchain with C++ support enabled"
	depends on !BR2_INSTALL_LIBSTDCPP
```

## package/mpdstate/Config.in
```kconfig
config BR2_PACKAGE_MPDSTATE
	bool "mpdstate"
	help
	  mpdstate is a small C-program which outputs the state of an MPD
	  (Music Player Daemon). The program keeps waiting for changes and
	  outputs immediately the state changes that I found important.

	  The output is easily parsed with shell scripting,
	  and that is how I automate my MPD boxes to:
	  - enable a LED when MPD is playing
	  - activate the power amplifier's power when MPD is playing
```

## package/mqttalrm/Config.in
```kconfig
config BR2_PACKAGE_MQTTALRM
	bool "MQTT Alarm clock"
	select BR2_PACKAGE_MOSQUITTO
	help
	  mqttalrm is a set of tools to compose an alarm clock
	  using MQTT to cooperate.
	  The system also provides a Web GUI to control/monitor
	  the alarm clock.

if BR2_PACKAGE_MQTTALRM
config BR2_PACKAGE_MQTTALRM_WEBGUI
	bool "install WEB gui"
	select BR2_PACKAGE_LIBWEBSOCKETS
	help
	  Say y to install the alarm.html on the target system
endif
```

## package/mumudvb/Config.in
```kconfig
config BR2_PACKAGE_MUMUDVB
	bool "MuMuDVB"
	depends on BR2_TOOLCHAIN_HAS_THREADS
	select BR2_PACKAGE_LIBICONV if !BR2_ENABLE_LOCALE
	help
	
	  DVBlast is a simple and powerful MPEG-2/TS demux and
	  streaming application.

	  http://www.videolan.org/projects/dvblast.html

	  MuMuDVB (Multi Multicast DVB) is a program that
	  redistributes streams from DVB or ATSC (Digital Television)
	  on a network (also called IPTV)
	  using multicasting or HTTP unicast.
	  It supports satellite, terrestrial and cable TV, in clear or
	  scrambled channels and run on PC as well as several embedded
	  platforms.
	  It is intended to multicast (the stream is sent
	  once and the network equipments split the data for the
	  different clients) a whole DVB transponder
	  (set of channels sent on the same carrier frequency)
	  by assigning each channel a different multicast group.
	  It detects the different services present as well as their
	  important parameters for streaming, rewrite the main
	  DVB tables to show clients only the right stream
	  in each group. 

	  History : MuMuDVB is originally a modification of dvbstream
	  that http://www.crans.org[cr@ns] made to stream TV
	  in a few hundred rooms.

	  http://mumumdvb.braice.net

comment 'mumudvb needs a toolchain w/ threads'
	depends on !BR2_TOOLCHAIN_HAS_THREADS
```

## package/networktest/Config.in
```kconfig
config BR2_PACKAGE_NETWORKTEST
	bool "networktest2"
	help
	  networktest2 is a client+server network test program.
	  A client broadcasts UDP traffic onto the network.
	  Any server replies the packet with a unicast, and the
	  client then receives N replies on it packet.
	  This can be used to test a network connection.
```

## package/rund/Config.in
```kconfig
config BR2_PACKAGE_RUND
	bool "rund init daemon"
	help
	  /sbin/init - parent of all processes

	  rund merges the best of 2 init approaches.
	  rund itself is an init daemon that only supervises services.
	  The boot process is offloaded to an external bootscript.
	  This bootscript or any other process can ask rund to
	  run+supervise processes.
	  The configuration of the boot process is reduced to shell script,
	  or any other program of your choice.
	  Yet, complex constructs for service selection
	  remain possible.

	  Spawning services in parallel during boot is easily done
	  with backgrounding parts of the script, a technique that existed
	  for years.

if BR2_PACKAGE_RUND
config BR2_PACKAGE_RUND_HALT
	bool "install rund shutdown script"
	default y
	help
	  The shutdown script provided by run is able to
	  detect the running init system and act differently
	  according that information.
	  It can halt/poweroff/reboot rund, busybox init, sysvinit, systemd.

endif
```

## package/wireshark/Config.in
```kconfig
config BR2_PACKAGE_WIRESHARK
	bool "Wireshark"
	select BR2_PACKAGE_LIBGTK2
	select BR2_PACKAGE_LIBPCAP
	default n
	help
	  This is a network protocoll analizer.
```
